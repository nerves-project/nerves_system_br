## package/elixir/Config.in.host
```kconfig
config BR2_PACKAGE_HOST_ELIXIR
	bool "host elixir"
	select BR2_PACKAGE_ERLANG
	help
	  Elixir is a functional, meta-programming aware language built on top of
	  the Erlang VM.

	  http://elixir-lang.org
```

## package/erlang-elixir/Config.in.host
```kconfig
config BR2_PACKAGE_HOST_ERLANG_ELIXIR
	bool "host erlang-elixir"
	depends on BR2_PACKAGE_ERLANG
	help
	  Elixir programming environemnt
	  http://elixir-lang.org
	  
```

## package/erlang-fwtool/Config.in.host
```kconfig
config BR2_PACKAGE_HOST_ERLANG_FWTOOL
	bool "host erlang-fwtool"
	depends on BR2_PACKAGE_ERLANG
	select BR2_PACKAGE_HOST_ERLANG_REBAR
	help
	  A firmware packaging and programming tool
	  written in Erlang.

	  http://github.com/nerves-project/fwtool
```
