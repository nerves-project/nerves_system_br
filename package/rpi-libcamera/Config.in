## package/rpi-libcamera/Config.in
```kconfig
config BR2_PACKAGE_RPI_LIBCAMERA_ARCH_SUPPORTS
	bool
	default y
	# Invalid packing size of ControlValue struct on m68k
	depends on !BR2_m68k
	depends on !BR2_TOOLCHAIN_HAS_BINUTILS_BUG_27597

menuconfig BR2_PACKAGE_RPI_LIBCAMERA
	bool "rpi-libcamera"
	depends on BR2_PACKAGE_RPI_LIBCAMERA_ARCH_SUPPORTS
	depends on BR2_INSTALL_LIBSTDCPP
	depends on BR2_TOOLCHAIN_HAS_THREADS
	depends on BR2_TOOLCHAIN_GCC_AT_LEAST_8 # C++17
	depends on !BR2_STATIC_LIBS # gnutls
	depends on BR2_USE_WCHAR # gnutls
	select BR2_PACKAGE_GNUTLS
	select BR2_PACKAGE_LIBYAML
	help
	  libcamera provides a software stack to support
	  complex devices that need heavy hardware image
	  processing operations.

	  THIS IS THE RASPBERRY PI FORK.

	  https://github.com/raspberrypi/libcamera

if BR2_PACKAGE_RPI_LIBCAMERA

config BR2_PACKAGE_RPI_LIBCAMERA_V4L2
	bool "libcamera v4l2 compatibility layer"
	help
	  libcamera v4l2 compatibility layer

config BR2_PACKAGE_RPI_LIBCAMERA_PIPELINE_SIMPLE
	bool "simple pipeline"
	help
	  Pipeline for simple pipelines.

config BR2_PACKAGE_RPI_LIBCAMERA_PIPELINE_UVCVIDEO
	bool "uvcvideo pipeline"
	help
	  Pipeline for uvcvideo devices.

endif # BR2_PACKAGE_RPI_LIBCAMERA

comment "rpi-libcamera needs a toolchain w/ C++, threads, wchar, dynamic library, gcc >= 8"
	depends on BR2_PACKAGE_RPI_LIBCAMERA_ARCH_SUPPORTS
	depends on !BR2_INSTALL_LIBSTDCPP || !BR2_TOOLCHAIN_HAS_THREADS || \
		!BR2_TOOLCHAIN_GCC_AT_LEAST_8 || BR2_STATIC_LIBS || !BR2_USE_WCHAR
```

## package/rpi-libpisp/Config.in
```kconfig
config BR2_PACKAGE_RPI_LIBPISP
	bool "rpi-libpisp"
	depends on BR2_INSTALL_LIBSTDCPP
	depends on BR2_TOOLCHAIN_HAS_THREADS
	depends on BR2_TOOLCHAIN_GCC_AT_LEAST_8 # C++17
	select BR2_PACKAGE_JSON_FOR_MODERN_CPP
	help
	  A helper library to generate run-time configuration
	  for the Raspberry Pi ISP (PiSP)

	  https://github.com/raspberrypi/libpisp

comment "rpi-libpisp needs a toolchain w/ C++, threads, wchar, dynamic library, gcc >= 8"
	depends on !BR2_INSTALL_LIBSTDCPP || !BR2_TOOLCHAIN_HAS_THREADS || \
		!BR2_TOOLCHAIN_GCC_AT_LEAST_8 || BR2_STATIC_LIBS || !BR2_USE_WCHAR
```

## package/tpm2-tss-engine/Config.in
```kconfig
config BR2_PACKAGE_TPM2_TSS_ENGINE
	bool "tpm2-tss-engine"
	select BR2_PACKAGE_TPM2_TSS
	help
	  The tpm2-tss-engine project implements a cryptographic engine for
	  OpenSSL for Trusted Platform Module (TPM 2.0) using the tpm2-tss
	  software stack that follows the Trusted Computing Groups (TCG)
	  TPM Software Stack (TSS 2.0). It uses the Enhanced System API (ESAPI)
	  interface of the TSS 2.0 for downwards communication. It supports
	  RSA decryption and signatures as well as ECDSA signatures.
```

## package/wpa_supplicant_s1g/Config.in
```kconfig
menuconfig BR2_PACKAGE_WPA_SUPPLICANT_S1G
	bool "wpa_supplicant_s1g"
	depends on BR2_USE_MMU # fork()
	depends on BR2_TOOLCHAIN_HAS_THREADS # nl80211 support
	select BR2_PACKAGE_LIBOPENSSL_ENABLE_DES if BR2_PACKAGE_LIBOPENSSL
	select BR2_PACKAGE_LIBOPENSSL_ENABLE_MD4 if BR2_PACKAGE_LIBOPENSSL
	help
	  Morse Micro WPA supplicant for secure wireless networks

	  https://github.com/MorseMicro/hostap

if BR2_PACKAGE_WPA_SUPPLICANT_S1G

config BR2_PACKAGE_WPA_SUPPLICANT_S1G_IBSS_RSN
	bool "Enable IBSS RSN"
	depends on BR2_PACKAGE_WPA_SUPPLICANT_S1G_NL80211
	help
	  Enable support for RSN/WPA2 in Ad-Hoc mode.

config BR2_PACKAGE_WPA_SUPPLICANT_S1G_AP_SUPPORT
	bool "Enable AP mode"
	depends on BR2_PACKAGE_WPA_SUPPLICANT_S1G_NL80211
	help
	  With this option enabled, wpa_supplicant can act as an
	  access point much like hostapd does with a limited feature
	  set.  This links in parts of hostapd functionality into
	  wpa_supplicant, making it bigger but dispensing the need for
	  a separate hostapd binary in some applications hence being
	  smaller overall.  It also enables support for Wi-Fi Direct.

config BR2_PACKAGE_WPA_SUPPLICANT_S1G_WIFI_DISPLAY
	bool "Enable Wi-Fi Display"
	depends on BR2_PACKAGE_WPA_SUPPLICANT_S1G_AP_SUPPORT
	help
	  Enable support for Wi-Fi Display

config BR2_PACKAGE_WPA_SUPPLICANT_S1G_MESH_NETWORKING
	bool "Enable mesh networking"
	depends on BR2_PACKAGE_WPA_SUPPLICANT_S1G_AP_SUPPORT
	select BR2_PACKAGE_OPENSSL
	select BR2_PACKAGE_OPENSSL_FORCE_LIBOPENSSL
	help
	  Enable support for open and secured mesh networking
	  (IEEE 802.11s)

config BR2_PACKAGE_WPA_SUPPLICANT_S1G_OVERRIDES
	bool "Enable HT/VHT/HE overrides"
	help
	  Enable wpa_supplicant overrides for HT, VHT and HE (disable
	  HT/HT40, mask MCS rates, etc.) in wpa_supplicant
	  configuration file.

config BR2_PACKAGE_WPA_SUPPLICANT_S1G_AUTOSCAN
	bool "Enable autoscan"
	help
	  Enable support for the autoscan feature (allow periodic scan)

config BR2_PACKAGE_WPA_SUPPLICANT_S1G_EAP
	bool "Enable EAP"
	help
	  Enable support for EAP, 802.1x/WPA-Enterprise and FILS.

config BR2_PACKAGE_WPA_SUPPLICANT_S1G_HOTSPOT
	bool "Enable HS20"
	select BR2_PACKAGE_WPA_SUPPLICANT_S1G_EAP
	help
	  Enable Hotspot 2.0 and IEEE 802.11u interworking
	  functionality.

config BR2_PACKAGE_WPA_SUPPLICANT_S1G_DEBUG_SYSLOG
	bool "Enable syslog support"
	help
	  Enable support for sending debug messages to syslog.

config BR2_PACKAGE_WPA_SUPPLICANT_S1G_WPS
	bool "Enable WPS"
	help
	  Enable support for Wi-Fi Protected Setup (WPS).

config BR2_PACKAGE_WPA_SUPPLICANT_S1G_CLI
	bool "Install wpa_cli binary"
	select BR2_PACKAGE_WPA_SUPPLICANT_S1G_CTRL_IFACE
	help
	  Install wpa_cli command line utility

config BR2_PACKAGE_WPA_SUPPLICANT_S1G_WPA_CLIENT_SO
	bool "Install wpa_client shared library"
	depends on !BR2_STATIC_LIBS
	help
	  Install libwpa_client.so.

comment "wpa_client library needs a toolchain w/ dynamic library"
	depends on BR2_STATIC_LIBS

config BR2_PACKAGE_WPA_SUPPLICANT_S1G_PASSPHRASE
	bool "Install wpa_passphrase binary"
	help
	  Install wpa_passphrase command line utility.

config BR2_PACKAGE_WPA_SUPPLICANT_S1G_CTRL_IFACE
	bool "Enable the Unix-socket control interface"
	help
	  Enable support for the Unix-socket-based API.

config BR2_PACKAGE_WPA_SUPPLICANT_S1G_DBUS
	bool "Enable support for the DBus control interface"
	depends on BR2_TOOLCHAIN_HAS_THREADS # dbus
	select BR2_PACKAGE_DBUS
	help
	  Enable support for the DBus control interface.

comment "dbus support needs a toolchain w/ threads"
	depends on !BR2_TOOLCHAIN_HAS_THREADS

config BR2_PACKAGE_WPA_SUPPLICANT_S1G_DBUS_INTROSPECTION
	bool "Introspection support"
	depends on BR2_PACKAGE_WPA_SUPPLICANT_S1G_DBUS
	help
	  Add introspection support for the DBus control interface.

config BR2_PACKAGE_WPA_SUPPLICANT_S1G_SMARTCARD
	bool "Smartcard support"
	help
	  Enable the smart card support. Required for OpenSSL engines
	  to work using PKCS11 and 802.1x

endif
```

## tests/smoke-test/Config.in
```kconfig
# Load custom packages
source "$NERVES_DEFCONFIG_DIR/package/my-package/Config.in"
```

## tests/smoke-test/nerves_defconfig
```kconfig
BR2_arm=y
BR2_cortex_a8=y
BR2_ARM_FPU_VFPV3=y
BR2_TAR_OPTIONS="--no-same-owner"
BR2_OPTIMIZE_2=y
BR2_GLOBAL_PATCH_DIR="${BR2_EXTERNAL_NERVES_PATH}/patches"
BR2_TOOLCHAIN_EXTERNAL=y
BR2_ROOTFS_SKELETON_CUSTOM=y
BR2_ROOTFS_SKELETON_CUSTOM_PATH="${BR2_EXTERNAL_NERVES_PATH}/board/nerves-common/skeleton"
BR2_INIT_NONE=y
BR2_ENABLE_LOCALE_WHITELIST="locale-archive"
BR2_GENERATE_LOCALE="en_US.UTF-8"
BR2_ROOTFS_OVERLAY="${BR2_EXTERNAL_NERVES_PATH}/board/nerves-common/rootfs_overlay ${NERVES_DEFCONFIG_DIR}/rootfs_overlay"
BR2_ROOTFS_POST_BUILD_SCRIPT="${NERVES_DEFCONFIG_DIR}/run_scrubber.sh"
BR2_ROOTFS_POST_IMAGE_SCRIPT="${NERVES_DEFCONFIG_DIR}/verify.sh"
BR2_PACKAGE_BUSYBOX_CONFIG="${BR2_EXTERNAL_NERVES_PATH}/board/nerves-common/busybox.config"
# BR2_TARGET_ROOTFS_TAR is not set
BR2_NERVES_SYSTEM_NAME="nerves_system_test"
BR2_PACKAGE_NERVES_CONFIG=y
BR2_PACKAGE_NERVES_CONFIG_ACCEPT_RNG_NOTICE=y
BR2_PACKAGE_MY_PACKAGE=y
BR2_PACKAGE_RPI_DISTRO_FIRMWARE_NONFREE=y
```

## tests/test-rootfs-additions/test_defconfig
```kconfig
BR2_arm=y
BR2_cortex_a8=y
BR2_ARM_FPU_VFPV3=y
BR2_TOOLCHAIN_EXTERNAL=y
BR2_INIT_NONE=y
# BR2_TARGET_GENERIC_GETTY is not set
# BR2_TARGET_GENERIC_REMOUNT_ROOTFS_RW is not set
BR2_ROOTFS_OVERLAY="${NERVES_SYSTEM}/board/nerves-common/rootfs-additions ${NERVES_DEFCONFIG_DIR}/rootfs-additions"
BR2_ROOTFS_POST_IMAGE_SCRIPT="${NERVES_DEFCONFIG_DIR}/verify.sh"
BR2_PACKAGE_BUSYBOX_CONFIG="${NERVES_SYSTEM}/board/nerves-common/busybox-1.22.config"
BR2_NERVES_SYSTEM_NAME="nerves_system_test"
```

## tests/test-user-package/package/my-package/Config.in
```kconfig
config BR2_PACKAGE_MY_PACKAGE
	bool "my-package"
	help
	  This is a test of adding your non-BEAM packages to Nerves.
	  Of course, it's nice to push your custom packages upstream
	  to Buildroot or Nerves, but if you have something new or
	  proprietary, this is a place to put it.
```
