## package/erlang-history/Config.in
```kconfig
config BR2_PACKAGE_ERLANG_HISTORY
	bool "erlang-history"
	depends on BR2_PACKAGE_ERLANG
	help
	  Hacks to add shell history to Erlang's shell

	  http://github.com/ferd/erlang-history
```

## package/erlang-rebar/Config.in.host
```kconfig
config BR2_PACKAGE_HOST_ERLANG_REBAR
	bool "host erlang-rebar"
	depends on BR2_PACKAGE_ERLANG
	help
	  Erlang build tool that makes it easy to compile and test Erlang
	  applications, port drivers and releases.

	  http://github.com/rebar/rebar
```

## package/erlang-relsync/Config.in.host
```kconfig
config BR2_PACKAGE_HOST_ERLANG_RELSYNC
	bool "host erlang-relsync"
	depends on BR2_PACKAGE_ERLANG
	select BR2_PACKAGE_HOST_ERLANG_REBAR
	help
	  Synchronize Erlang/OTP releases on remote nodes
	  using distributed Erlang.

	  http://github.com/fhunleth/relsync
```

## package/erlang-relx/Config.in.host
```kconfig
config BR2_PACKAGE_HOST_ERLANG_RELX
	bool "host erlang-relx"
	depends on BR2_PACKAGE_ERLANG
	help
	  A release assembler for Erlang.

	  http://github.com/erlware/relx
```

## package/erlinit/Config.in
```kconfig
config BR2_PACKAGE_ERLINIT
	bool "erlinit"
	depends on BR2_PACKAGE_ERLANG
	help
	  Erlinit is a replacement for /sbin/init that starts erlang.

	  https://github.com/nerves-project/erlinit
```

## package/fwup/Config.in
```kconfig
config BR2_PACKAGE_FWUP
	bool "fwup"
	depends on BR2_USE_MMU
	select BR2_PACKAGE_LIBARCHIVE
	select BR2_PACKAGE_ZLIB        # required by libarchive to include zip compression
	select BR2_PACKAGE_LIBCONFUSE
	help
	  Fwup is a scriptable embedded Linux firmware update creator and runner.

	  https://github.com/fhunleth/fwup

comment "fwup needs a toolchain w/ wchar"
	depends on !BR2_USE_WCHAR
```

## package/lfe/Config.in
```kconfig
config BR2_PACKAGE_LFE
	bool "lfe"
	select BR2_PACKAGE_ERLANG
	help
	  LFE is a functional LISP-2 built on top of the Erlang VM.

	  http://lfe.io/
```

## package/lfe/Config.in.host
```kconfig
config BR2_PACKAGE_HOST_LFE
	bool "host lfe"
	select BR2_PACKAGE_ERLANG
	help
	  LFE is a functional LISP-2 built on top of the Erlang VM.
      
	  http://lfe.io/
```

## package/libp11/Config.in
```kconfig
config BR2_PACKAGE_LIBP11
	bool "libp11"
	depends on BR2_PACKAGE_OPENSSL
	depends on BR2_USE_MMU # fork()
	help
	  PKCS#11 wrapper library

	  https://github.com/OpenSC/libp11
```

## package/mmccopy/Config.in
```kconfig
config BR2_PACKAGE_MMCCOPY
	bool "mmccopy"
	help
	  The mmccopy utility is an easier-to-use alternative to dd for
	  writing images to SDCards and MMC memory.
	  
	  https://github.com/fhunleth/mmccopy
```

## package/mmccopy/Config.in.host
```kconfig
config BR2_PACKAGE_HOST_MMCCOPY
	bool "host mmccopy"
	help
	  The mmccopy utility is an easier-to-use alternative to dd for
	  writing images to SDCards and MMC memory.
	  
	  https://github.com/fhunleth/mmccopy
```

## package/morse_driver/Config.in
```kconfig
config BR2_PACKAGE_MORSE_DRIVER
	bool "morse_driver"
	help
	  Morse Micro WiFi HaLow Driver for Linux
```

## package/nbtty/Config.in
```kconfig
config BR2_PACKAGE_NBTTY
	bool "nbtty"
	depends on BR2_USE_MMU # fork()
	help
	  nbtty runs a program in a detached ptty that allows bytes
	  to be dropped.

	  https://github.com/fhunleth/nbtty
```

## package/nerves-config/Config.in
```kconfig
config BR2_PACKAGE_NERVES_CONFIG
	bool "nerves-config"
	select BR2_PACKAGE_ERLANG   # Erlang is required for all Nerves systems
	select BR2_PACKAGE_ERLINIT  # Always use erlinit to boot
	select BR2_PACKAGE_OPENSSL  # Used for Erlang crypto
	select BR2_PACKAGE_FWUP     # Used for OTA firmware updates
	select BR2_PACKAGE_NCURSES  # IEx shell is near impossible to use without
	select BR2_PACKAGE_NERVES_HEART # Nerves updates to Erlang's heartbeat support
	select BR2_PACKAGE_UBOOT_TOOLS  # Required for Nerves firmware metadata
	select BR2_PACKAGE_BOARDID  # ID board for assigning unique names
	select BR2_PACKAGE_HOST_FWUP # Used by Nerves packaging tools
	select BR2_TARGET_ROOTFS_SQUASHFS # Nerves uses squashfs archives
	help
	  Nerves system configuration helper. This selects a set of packages
	  used by all Nerves systems so that they're never accidentally omitted.

	  https://github.com/nerves-project/nerves_system_br

config BR2_PACKAGE_NERVES_CONFIG_ACCEPT_RNG_NOTICE
	bool "accept rng-tools is no longer required"
	help
	  Linux kernels prior to Linux 5.6 had many blocking issues when enough
	  entropy was not available at early boot. This caused many hangs and
	  was quite hard to debug if you weren't aware of the issue. As a
	  result, Nerves automatically set BR2_PACKAGE_RNG_TOOLS=y. This is no
	  longer an issue, so systems should choose whether they need it or not.
	  Select this to accept that you have seen this message and taking the
	  appropriate action for your Nerves system.
```

## package/nerves-demo/Config.in
```kconfig
config BR2_PACKAGE_NERVES_DEMO
	bool "nerves-demo"
	depends on BR2_PACKAGE_ERLANG
	select BR2_PACKAGE_HOST_ERLANG_RELX
	help
	  Nerves demonstration application

	  http://bitbucket.org/fhunleth/erlang_webcontrol
```

## package/nerves-id/Config.in
```kconfig
config BR2_PACKAGE_NERVES_ID
	bool "nerves-id"
	help
	  Print out a unique IDs to identify a board.
	  Doesn't something like this already exist?
```

## package/nerves-minimal/Config.in
```kconfig
config BR2_PACKAGE_NERVES_MINIMAL
	bool "nerves-minimal"
	depends on BR2_PACKAGE_ERLANG
	select BR2_PACKAGE_HOST_ERLANG_RELX
	help
	  Nerves minimal application

	  https://github.com/nerves-project/nerves-minimal
```

## package/nerves_heart/Config.in
```kconfig
config BR2_PACKAGE_NERVES_HEART
	bool "nerves_heart"
	depends on BR2_PACKAGE_ERLANG
	help
          Nerves Heart replaces Erlang's heart port process with one that
          supports hardware watchdogs.

	  https://github.com/nerves-project/nerves_heart
```

## package/nerves_initramfs/Config.in
```kconfig
config BR2_PACKAGE_NERVES_INITRAMFS
	bool "nerves_initramfs"
	help
          An initramfs for early boot handling of Nerves devices

	  https://github.com/nerves-project/nerves_initramfs
```

## package/pigpio/Config.in
```kconfig
config BR2_PACKAGE_PIGPIO
	bool "pigpio"
  depends on BR2_USE_MMU # fork()
  depends on BR2_TOOLCHAIN_HAS_THREADS
  depends on !BR2_STATIC_LIBS

	help
	  PIGPIO is a library for the Raspberry Pi which allows control of the General Purpose Input Outputs (GPIO).  Works on all versions of the Raspberry Pi.

	  https://github.com/joan2937/pigpio

  comment "pigpio needs a toolchain w/ threads, dynamic library"
          depends on !BR2_TOOLCHAIN_HAS_THREADS || BR2_STATIC_LIBS
```

## package/ply/Config.in
```kconfig
config BR2_PACKAGE_PLY
	bool "ply"
	depends on BR2_USE_MMU # fork()
	help
	  Dynamic Tracing in Linux

	  https://github.com/iovisor/ply
```

## package/python-pigpio/Config.in
```kconfig
config BR2_PACKAGE_PYTHON_PIGPIO
	bool "python-pigpio"
	depends on BR2_PACKAGE_PIGPIO
        select BR2_PACKAGE_PYTHON
        select BR2_PACKAGE_PYTHON_SSL
        select BR2_PACKAGE_PYTHON_HASHLIB

	help
	  Python module for communicating with PIGPIO daemon.

	  https://github.com/joan2937/pigpio
```

## package/raspijpgs/Config.in
```kconfig
config BR2_PACKAGE_RASPIJPGS
	bool "raspijpgs"
	depends on BR2_PACKAGE_RPI_USERLAND
	help
	  Simple MJPEG streamer for the Raspberry Pi.

	  https://github.com/fhunleth/raspijpgs/
```

## package/rpi-distro-bluez-firmware/Config.in
```kconfig
config BR2_PACKAGE_RPI_DISTRO_BLUEZ_FIRMWARE
	bool "rpi-distro-bluez-firmware"
	depends on BR2_arm || BR2_aarch64
	help
	  RaspberryPi Bluetooth Firmware

	  Firmware binaries that ship with the Raspberry Pi OS

	  https://github.com/RPi-Distro/bluez-firmware
```

## package/rpi-distro-firmware-nonfree/Config.in
```kconfig
config BR2_PACKAGE_RPI_DISTRO_FIRMWARE_NONFREE
	bool "rpi-distro-firmware-nonfree"
	depends on BR2_arm || BR2_aarch64
	depends on !BR2_PACKAGE_LINUX_FIRMWARE_BRCM_BCM43XXX
	depends on !BR2_PACKAGE_RPI_WIFI_FIRMWARE
	help
	  RaspberryPi OS Firmware

	  Firmware binaries that ship with the Raspberry Pi OS

	  https://github.com/RPi-Distro/firmware-nonfree

comment "rpi-distro-firmware-nonfree conflicts with linux-firmware Broadcom BRCM bcm43xx and rpi-wifi-firmware"
	depends on BR2_PACKAGE_LINUX_FIRMWARE_BRCM_BCM43XXX || BR2_PACKAGE_RPI_WIFI_FIRMWARE
```
